/* Copyright (c) 2013-2014, The Linux Foundation. All rights reserved.
 *
 * This program is free software; you can redistribute it and/or modify
 * it under the terms of the GNU General Public License version 2 and
 * only version 2 as published by the Free Software Foundation.
 *
 * This program is distributed in the hope that it will be useful,
 * but WITHOUT ANY WARRANTY; without even the implied warranty of
 * MERCHANTABILITY or FITNESS FOR A PARTICULAR PURPOSE.  See the
 * GNU General Public License for more details.
 */

/*---------------------------------------------------------------------------
 * This file is autogenerated file using gcdb parser. Please do not edit it.
 * Update input XML file to add a new entry or update variable in this file
 * VERSION = "1.0"
 *---------------------------------------------------------------------------*/
&mdss_mdp {
	dsi_td4291_jdi_720p_vid: qcom,mdss_dsi_td4291_jdi_720p_video {
		qcom,mdss-dsi-panel-name = "td4291 jdi 720p video mode dsi panel";
		qcom,cont-splash-enabled;
		qcom,suspend-ulps-enable;
		qcom,mdss-dsi-panel-controller = <&mdss_dsi0>;
		qcom,mdss-dsi-panel-type = "dsi_video_mode";
		qcom,mdss-dsi-panel-destination = "display_1";
		qcom,mdss-dsi-panel-framerate = <60>;
		qcom,mdss-dsi-virtual-channel-id = <0>;
		qcom,mdss-dsi-stream = <0>;
		qcom,mdss-dsi-panel-width = <720>;
		qcom,mdss-dsi-panel-height = <1280>;
		qcom,mdss-dsi-h-front-porch = <96>;
		qcom,mdss-dsi-h-back-porch = <72>;
		qcom,mdss-dsi-h-pulse-width = <40>;
		qcom,mdss-dsi-h-sync-skew = <0>;
		qcom,mdss-dsi-v-back-porch = <4>;
		qcom,mdss-dsi-v-front-porch = <12>;
		qcom,mdss-dsi-v-pulse-width = <4>;
		qcom,mdss-dsi-h-left-border = <0>;
		qcom,mdss-dsi-h-right-border = <0>;
		qcom,mdss-dsi-v-top-border = <0>;
		qcom,mdss-dsi-v-bottom-border = <0>;
		qcom,mdss-dsi-bpp = <24>;
		qcom,mdss-dsi-color-order = "rgb_swap_rgb";
		qcom,mdss-dsi-underflow-color = <0xff>;
		qcom,mdss-dsi-border-color = <0>;
		qcom,mdss-dsi-on-command = [//05 01 00 00 00 00 02 01 00 /* SW reset */
		    05 01 00 00 00 00 02 de 00
		    15 01 00 00 00 00 02 b4 32 //32->31 esd flicker lpx=32: 100ns->31: 50ns
		    15 01 00 00 00 00 02 b3 70
		    15 01 00 00 00 00 02 b0 7c //ignore sot error
		    //15 01 00 00 00 00 02 dc bc //psclk
		    //15 01 00 00 00 00 02 dc 97 //test for wcdma bs
		    15 01 00 00 00 00 02 d5 65
		    15 01 00 00 00 00 02 d6 77
		    15 01 00 00 00 00 02 d7 76
		    15 01 00 00 00 00 02 d8 13
		    05 01 00 00 00 00 02 df 00

     		//05 01 00 00 00 00 02 de 00  //reg mode
			//15 01 00 00 00 00 02 C5 7A   //pwm on
			//05 01 00 00 00 00 02 df 00   //command mode

            15 01 00 00 05 00 02 53 00 /* brightness control on and pwm on and cabc off(27 is cabc on, 24 is cabc off) */
            15 01 00 00 05 00 02 51 00
            15 01 00 00 05 00 02 5E 00
            15 01 00 00 05 00 02 55 01

            05 01 00 00 32 00 02 11 00
			05 01 00 00 01 00 02 29 00
		    ];
		qcom,mdss-dsi-off-command = [
                    //05 01 00 00 00 00 02 de 00  //reg mode
				    //15 01 00 00 00 00 02 C5 78   //pwm off
				    //05 01 00 00 00 00 02 df 00   //command mode        

		            15 01 00 00 05 00 02 53 20 /* pwm off */
				    05 01 00 00 0a 00 02 28 00
				    05 01 00 00 32 00 02 10 00
					];
    qcom,mdss-dsi-on-command-wakeup-gesture = [
            05 01 00 00 00 00 02 E5 01
            05 01 00 00 32 00 02 11 00
	    05 01 00 00 01 00 02 29 00
		    ];
		qcom,mdss-dsi-off-command-wakeup-gesture = [		        
				    05 01 00 00 0a 00 02 28 00
				    05 01 00 00 32 00 02 10 00
				    05 01 00 00 00 00 02 E4 01
					];
        qcom,mdss-dsi-CEdefault-command = [
        05 01 00 00 00 00 02 de 00
        15 01 00 00 00 00 02 d5 00
        15 01 00 00 00 00 02 d6 00
        15 01 00 00 00 00 02 d7 00
        15 01 00 00 00 00 02 d8 00
        05 01 00 00 00 00 02 df 00];    
        qcom,mdss-dsi-CEbright-command = [
        05 01 00 00 00 00 02 de 00
        15 01 00 00 00 00 02 d5 65
        15 01 00 00 00 00 02 d6 77
        15 01 00 00 00 00 02 d7 76
        15 01 00 00 00 00 02 d8 13
        05 01 00 00 00 00 02 df 00];     //zhangjian add for CE enhance
 	
		qcom,mdss-dsi-on-command-state = "dsi_lp_mode";
		qcom,mdss-dsi-off-command-state = "dsi_hs_mode";
		qcom,mdss-dsi-on-command-wakeup-gesture-state = "dsi_lp_mode";
		qcom,mdss-dsi-off-command-wakeup-gesture-state = "dsi_hs_mode";
		qcom,mdss-dsi-CEdefault-command-state = "dsi_lp_mode";
		qcom,mdss-dsi-CEbright-command-state = "dsi_hs_mode";
		qcom,mdss-dsi-h-sync-pulse = <1>;
		qcom,mdss-dsi-traffic-mode = "burst_mode";
		qcom,mdss-dsi-bllp-eof-power-mode;
		qcom,mdss-dsi-bllp-power-mode;
		qcom,mdss-dsi-lane-0-state;
		qcom,mdss-dsi-lane-1-state;
		qcom,mdss-dsi-lane-2-state;
		qcom,mdss-dsi-lane-3-state;
		qcom,mdss-dsi-panel-timings = [81 1C 12 00 40 42 16 1E 2d 03 04 00];//lpx=100ns
		//qcom,mdss-dsi-panel-timings = [82 1C 12 00 40 42 16 1E 14 03 04 00];//lpx=50ns
		qcom,mdss-dsi-t-clk-post = <0x04>;
		qcom,mdss-dsi-t-clk-pre = <0x1D>;//lpx=100ns
		//qcom,mdss-dsi-t-clk-pre = <0x1B>;//lpx=50ns
		qcom,mdss-dsi-bl-min-level = <10>;
		qcom,mdss-dsi-bl-max-level = <205>;
		qcom,mdss-dsi-dma-trigger = "trigger_sw";
		qcom,mdss-dsi-mdp-trigger = "none";
		qcom,mdss-dsi-bl-pmic-control-type = "bl_ctrl_dcs";
		//om,mdss-dsi-reset-sequence = <0 20>, <1 150>;
		//qcom,mdss-dsi-reset-sequence = <1 1>, <0 1>, <1 160>;
		qcom,mdss-dsi-reset-sequence =  <0 5>, <1 150>;
		//qcom,mdss-dsi-lp11-init; //add lp11_init
		//zte-modify,yyp,add lcd esd test, begin
	       /*qcom,mdss-dsi-panel-status-command = [06 01 00 01 05 00 02 0A 00];
		qcom,mdss-dsi-panel-status-command-state = "dsi_hs_mode";		
		qcom,mdss-dsi-panel-status-check-mode = "reg_read";		
		qcom,mdss-dsi-panel-status-value = <0x9C>;		
		qcom,esd-check-enabled; */
		//zte-modify,yyp,add lcd esd test, end
		qcom,mdss-dsi-tx-eot-append;
		qcom,mdss-dsi-rx-eot-ignore;
		qcom,mdss-dsi-init-delay-us = <0x14>;
	};
};
